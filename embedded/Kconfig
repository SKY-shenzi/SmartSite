## embedded/Kconfig
```kconfig
config FAN_PWM_CHANNEL
    int
    prompt "set the cement area fan PWM channel."
    default 2
    depends on ENABLE_CEMENT_AREA

config FAN_PWM_GROUP_ID
    int
    prompt "set the cement area fan PWM group id."
    default 0
    depends on ENABLE_CEMENT_AREA

config FAN_PWM_PIN
    int
    prompt "set the cement area fan PWM GPIO."
    default 2
    depends on ENABLE_CEMENT_AREA

config FAN_PWM_PIN_MODE
    int
    prompt "set the cement area fan PWM pin mode."
    default 1
    depends on ENABLE_CEMENT_AREA

config FAN_PWM_FREQ_HZ
    int
    prompt "set the cement area fan PWM frequency."
    default 1000
    depends on ENABLE_CEMENT_AREA

config FAN_PWM_DUTY_PERCENT
    int
    prompt "set the cement area fan PWM duty percent when on."
    default 100
    depends on ENABLE_CEMENT_AREA

config FAN_MOTOR_AIN1_PIN
    int
    prompt "set the TB6612 AIN1 GPIO for cement area fan."
    default 10
    depends on ENABLE_CEMENT_AREA

config FAN_MOTOR_AIN2_PIN
    int
    prompt "set the TB6612 AIN2 GPIO for cement area fan."
    default 11
    depends on ENABLE_CEMENT_AREA

config FAN_RELAY_PIN
    int
    prompt "legacy fan GPIO, kept for compatibility."
    default 2
    depends on ENABLE_CEMENT_AREA

config FAN_RELAY_ACTIVE_LEVEL
    int
    prompt "legacy fan active level, kept for compatibility."
    default 1
    depends on ENABLE_CEMENT_AREA

config BEEP_PIN
    int
    prompt "set the cement area beeper GPIO."
    default 0
    depends on ENABLE_CEMENT_AREA

config BEEP_ACTIVE_LEVEL
    int
    prompt "set the beeper active level, 1 high, 0 low."
    default 1
    depends on ENABLE_CEMENT_AREA
```

## embedded/timber-area/Kconfig
```kconfig
config LDR_ADC_CHANNEL
    int
    prompt "set the ldr adc channel."
    default 5
    depends on ENABLE_HUAWEIIOT

config MQ2_ADC_CHANNEL
    int
    prompt "set the mq2 smoke adc channel."
    default 0
    depends on ENABLE_HUAWEIIOT
```
